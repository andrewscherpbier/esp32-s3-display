## apps/flight_tracker/main/Kconfig.projbuild
```kconfig
menu "Flight tracker"

    config FLIGHT_HOME_LAT
        string "Home latitude (decimal degrees, e.g. 51.4779)"
        default ""
        help
            Centre of the home view. Leave empty (with the longitude) to use the approximate
            location from the IP address. Stored in sdkconfig, which isn't committed, so it
            stays out of the repository.

    config FLIGHT_HOME_LON
        string "Home longitude (decimal degrees, e.g. -0.0015)"
        default ""

    config FLIGHT_MAP_API_KEY
        string "Stadia Maps API key"
        default ""
        help
            Map tiles come from Stadia Maps ("Alidade Smooth Dark"), which needs a free
            account: sign up at https://client.stadiamaps.com, add a property, and copy its
            API key here. Without a key the map stays blank (aircraft still show). Like the
            coordinates above, this lives in sdkconfig, which isn't committed.

    config FLIGHT_START_ZOOM
        int "Starting map zoom"
        range 3 14
        default 10
        help
            10 shows roughly 20 nautical miles around home; each step halves or doubles it.

endmenu
```
